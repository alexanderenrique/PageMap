## firmware/main/Kconfig.projbuild
```kconfig
menu "PageMap"

    config ESP_READER_DEFAULT_DOC_PATH
        string "Default document scan path"
        default "/sdcard/documents"
        help
            Root directory on SD card containing packaged documents.

    config ESP_READER_TILE_CACHE_BUDGET
        int "Tile cache budget (tiles)"
        default 24
        range 4 128
        help
            Maximum number of decoded RGB565 tiles kept in LRU cache.

    config ESP_READER_DEBUG_OVERLAY
        bool "Enable debug overlay by default"
        default n
        help
            Show decode/SD/cache metrics overlay on reader screen.

    config ESP_READER_PROGRESS_DEBOUNCE_MS
        int "Progress save debounce (ms)"
        default 2000
        range 500 30000

endmenu
```

## firmware/sdkconfig.defaults
```kconfig
# Target: ESP32-S3 (Waveshare ESP32-S3-Touch-LCD-7)
CONFIG_IDF_TARGET="esp32s3"

# CPU / RTOS
CONFIG_ESP_DEFAULT_CPU_FREQ_MHZ_240=y
CONFIG_FREERTOS_HZ=1000

# Flash 8MB QIO 80MHz
CONFIG_ESPTOOLPY_FLASHSIZE_8MB=y
CONFIG_ESPTOOLPY_FLASHMODE_QIO=y
CONFIG_ESPTOOLPY_FLASHFREQ_80M=y

# Octal PSRAM 80MHz
CONFIG_SPIRAM=y
CONFIG_SPIRAM_MODE_OCT=y
CONFIG_SPIRAM_SPEED_80M=y
CONFIG_SPIRAM_FETCH_INSTRUCTIONS=y
CONFIG_SPIRAM_RODATA=y

# Performance
CONFIG_COMPILER_OPTIMIZATION_PERF=y
CONFIG_ESP32S3_DATA_CACHE_LINE_64B=y

# FAT / SD
CONFIG_FATFS_LFN_HEAP=y
CONFIG_FATFS_MAX_LFN=255
# Keep FatFs LFN scratch buffers in internal RAM. Prefer-PSRAM + heap LFN has
# been a source of tlsf_free panics on fopen from worker tasks.
# CONFIG_FATFS_ALLOC_PREFER_EXTRAM is not set

# LVGL 9
CONFIG_LV_OS_FREERTOS=y
CONFIG_LV_USE_CLIB_MALLOC=y
CONFIG_LV_USE_CLIB_STRING=y
CONFIG_LV_USE_CLIB_SPRINTF=y
CONFIG_LV_DEF_REFR_PERIOD=15
CONFIG_LV_OBJ_STYLE_CACHE=y
CONFIG_LV_DRAW_SW_DRAW_UNIT_CNT=2
CONFIG_LV_USE_LOG=y
CONFIG_LV_LOG_LEVEL_WARN=y
CONFIG_LV_FONT_MONTSERRAT_12=y
CONFIG_LV_FONT_MONTSERRAT_14=y
CONFIG_LV_FONT_MONTSERRAT_16=y
CONFIG_LV_FONT_MONTSERRAT_20=y
```
